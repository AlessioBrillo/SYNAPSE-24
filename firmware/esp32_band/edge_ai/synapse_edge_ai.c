/**
 * @file synapse_edge_ai.c
 * @brief Edge AI Implementation (TFLM Stress Triage + Motion Classifier)
 * 
 * Wraps firmware/common/triage_inference and triage_features
 * Embedded models loaded from model_data.h (generated by quantize_and_deploy.py)
 */

#include <string.h>
#include "freertos/FreeRTOS.h"
#include "freertos/task.h"
#include "freertos/semphr.h"
#include "esp_log.h"
#include "esp_timer.h"
#include "synapse_edge_ai.h"
#include "triage_inference.h"
#include "triage_features.h"
#include "sensor_scheduler.h"
#include "synapse_config.h"

static const char *TAG = "SYNAPSE_EDGE_AI";

static synapse_edge_ai_t g_edge_ai = {0};
static SemaphoreHandle_t g_edge_ai_mutex = NULL;

// Model data (embedded from model_data.h generated by quantize_and_deploy.py)
// The actual model data is in firmware/common/triage/model_data.h
extern const unsigned char g_triage_model_data[];
extern const unsigned int g_triage_model_data_len;

// Inference task
static TaskHandle_t g_inference_task = NULL;
static bool g_inference_running = false;

static void inference_task_fn(void *arg) {
    (void)arg;
    TickType_t last_wake = xTaskGetTickCount();
    const TickType_t period_ticks = pdMS_TO_TICKS(200);  // 5Hz inference
    
    triage_input_t input = {0};
    triage_output_t output = {0};
    triage_features_t features = {0};
    
    ESP_LOGI(TAG, "Inference task started (5Hz)");
    
    while (g_inference_running) {
        vTaskDelayUntil(&last_wake, period_ticks);
        
        if (!g_edge_ai.models_loaded) continue;
        
        // ====================================================================
        // Stress Triage (uses IMU + PPG features)
        // ====================================================================
        if (triage_features_compute_live(&features) == ESP_OK) {
            input.timestamp_us = features.timestamp_us;
            input.feature_count = features.feature_count;
            for (int i = 0; i < TRIAGE_NUM_FEATURES; i++) {
                input.features[i] = features.features[i];
            }
            
            if (triage_inference_run(&g_edge_ai.stress_triage, &input, &output) == ESP_OK && output.valid) {
                if (xSemaphoreTake(g_edge_ai_mutex, pdMS_TO_TICKS(10)) == pdTRUE) {
                    g_edge_ai.latest_stress.baseline_prob = output.baseline_prob;
                    g_edge_ai.latest_stress.stress_prob = output.stress_prob;
                    g_edge_ai.latest_stress.artifact_prob = output.artifact_prob;
                    g_edge_ai.latest_stress.predicted_class = output.predicted_class;
                    g_edge_ai.latest_stress.inference_time_us = output.inference_time_us;
                    g_edge_ai.latest_stress.valid = true;
                    xSemaphoreGive(g_edge_ai_mutex);
                }
                
                ESP_LOGD(TAG, "Stress Triage: baseline=%.3f, stress=%.3f, artifact=%.3f, class=%d, time=%" PRId64 " us",
                         output.baseline_prob, output.stress_prob, output.artifact_prob,
                         output.predicted_class, output.inference_time_us);
            }
        }
        
        // ====================================================================
        // Motion Classifier (could use different features or same)
        // For now, reuse stress features but with different model
        // In production, would have separate feature extraction
        // ====================================================================
        // TODO: Implement motion classifier with dedicated model
    }
    
    vTaskDelete(NULL);
}

esp_err_t synapse_edge_ai_init(void) {
    if (g_edge_ai.initialized) return ESP_OK;
    
    g_edge_ai_mutex = xSemaphoreCreateMutex();
    if (!g_edge_ai_mutex) {
        ESP_LOGE(TAG, "Failed to create mutex");
        return ESP_ERR_NO_MEM;
    }
    
    // Initialize stress triage model
    esp_err_t ret = triage_inference_init(&g_edge_ai.stress_triage);
    if (ret != ESP_OK) {
        ESP_LOGE(TAG, "Failed to init stress triage: %s", esp_err_to_name(ret));
        return ret;
    }
    
    // Initialize motion classifier (same model for now, would be different in production)
    ret = triage_inference_init(&g_edge_ai.motion_classifier);
    if (ret != ESP_OK) {
        ESP_LOGE(TAG, "Failed to init motion classifier: %s", esp_err_to_name(ret));
        return ret;
    }
    
    // Triage owns its 4 s window, fed by synapse_signal_quality_process(). It only supports
    // 50 Hz IMU/PPG; on other rates log and keep triage disabled rather than abort boot.
    synapse_hw_config_t hw_cfg;
    if (synapse_config_get(&hw_cfg) == ESP_OK) {
        uint32_t ppg_hz = (hw_cfg.ppg_sample_rate == 0x02) ? 50 : 64;
        if (triage_features_init((uint32_t)hw_cfg.imu_accel_odr_hz, ppg_hz) != ESP_OK) {
            ESP_LOGE(TAG, "Stress triage disabled: need 50 Hz IMU/PPG (have imu=%d ppg=%u)",
                     hw_cfg.imu_accel_odr_hz, (unsigned)ppg_hz);
        }
    }
    
    memset(&g_edge_ai.latest_stress, 0, sizeof(stress_triage_t));
    memset(&g_edge_ai.latest_motion, 0, sizeof(motion_classifier_t));
    
    g_edge_ai.initialized = true;
    ESP_LOGI(TAG, "Edge AI initialized (TFLM stress triage + motion)");
    return ESP_OK;
}

esp_err_t synapse_edge_ai_run_stress_triage(stress_triage_t *result) {
    if (!result) return ESP_ERR_INVALID_ARG;
    if (!g_edge_ai.initialized) return ESP_ERR_INVALID_STATE;
    
    triage_input_t input = {0};
    triage_output_t output = {0};
    triage_features_t features = {0};
    
    if (triage_features_compute_live(&features) != ESP_OK) {
        return ESP_ERR_NOT_FINISHED;  // Not enough data
    }
    
    input.timestamp_us = features.timestamp_us;
    input.feature_count = features.feature_count;
    for (int i = 0; i < TRIAGE_NUM_FEATURES; i++) {
        input.features[i] = features.features[i];
    }
    
    esp_err_t ret = triage_inference_run(&g_edge_ai.stress_triage, &input, &output);
    if (ret == ESP_OK && output.valid) {
        result->baseline_prob = output.baseline_prob;
        result->stress_prob = output.stress_prob;
        result->artifact_prob = output.artifact_prob;
        result->predicted_class = output.predicted_class;
        result->inference_time_us = output.inference_time_us;
        result->valid = true;
        
        // Update cached result
        if (xSemaphoreTake(g_edge_ai_mutex, pdMS_TO_TICKS(10)) == pdTRUE) {
            g_edge_ai.latest_stress = *result;
            xSemaphoreGive(g_edge_ai_mutex);
        }
    }
    
    return ret;
}

esp_err_t synapse_edge_ai_run_motion_classifier(motion_classifier_t *result) {
    if (!result) return ESP_ERR_INVALID_ARG;
    if (!g_edge_ai.initialized) return ESP_ERR_INVALID_STATE;
    
    // TODO: Implement with dedicated motion model
    // For now, return placeholder
    result->walk_prob = 0.2f;
    result->run_prob = 0.1f;
    result->cycle_prob = 0.1f;
    result->stationary_prob = 0.5f;
    result->sleep_prob = 0.1f;
    result->predicted_class = 3;  // stationary
    result->inference_time_us = 0;
    result->valid = false;
    
    return ESP_ERR_NOT_SUPPORTED;
}

esp_err_t synapse_edge_ai_get_latest_stress(stress_triage_t *result) {
    if (!result) return ESP_ERR_INVALID_ARG;
    if (!g_edge_ai.initialized) return ESP_ERR_INVALID_STATE;
    
    if (xSemaphoreTake(g_edge_ai_mutex, pdMS_TO_TICKS(10)) == pdTRUE) {
        if (g_edge_ai.latest_stress.valid) {
            *result = g_edge_ai.latest_stress;
            xSemaphoreGive(g_edge_ai_mutex);
            return ESP_OK;
        }
        xSemaphoreGive(g_edge_ai_mutex);
    }
    return ESP_ERR_INVALID_STATE;
}

esp_err_t synapse_edge_ai_get_latest_motion(motion_classifier_t *result) {
    if (!result) return ESP_ERR_INVALID_ARG;
    if (!g_edge_ai.initialized) return ESP_ERR_INVALID_STATE;
    
    if (xSemaphoreTake(g_edge_ai_mutex, pdMS_TO_TICKS(10)) == pdTRUE) {
        if (g_edge_ai.latest_motion.valid) {
            *result = g_edge_ai.latest_motion;
            xSemaphoreGive(g_edge_ai_mutex);
            return ESP_OK;
        }
        xSemaphoreGive(g_edge_ai_mutex);
    }
    return ESP_ERR_INVALID_STATE;
}

bool synapse_edge_ai_is_high_stress(void) {
    if (!g_edge_ai.latest_stress.valid) return false;
    return g_edge_ai.latest_stress.stress_prob > 0.7f;
}

bool synapse_edge_ai_is_artifact(void) {
    if (!g_edge_ai.latest_stress.valid) return false;
    return g_edge_ai.latest_stress.artifact_prob > 0.5f;
}

esp_err_t synapse_edge_ai_get_model_info(edge_ai_model_t model, size_t *model_size, size_t *arena_used) {
    triage_inference_t *triage = (model == EDGE_AI_MODEL_STRESS_TRIAGE) 
        ? &g_edge_ai.stress_triage : &g_edge_ai.motion_classifier;
    
    return triage_inference_get_model_info(triage, model_size, arena_used);
}

// Start inference task (called after sensors are initialized)
esp_err_t synapse_edge_ai_start_inference_task(void) {
    if (g_inference_running) return ESP_OK;
    if (!g_edge_ai.models_loaded) return ESP_ERR_INVALID_STATE;
    
    g_inference_running = true;
    BaseType_t ret = xTaskCreate(inference_task_fn, "edge_ai_infer", 8192, NULL, 5, &g_inference_task);
    if (ret != pdPASS) {
        g_inference_running = false;
        return ESP_ERR_NO_MEM;
    }
    return ESP_OK;
}

esp_err_t synapse_edge_ai_stop_inference_task(void) {
    if (!g_inference_running) return ESP_OK;
    
    g_inference_running = false;
    if (g_inference_task) {
        vTaskDelay(pdMS_TO_TICKS(200));
        g_inference_task = NULL;
    }
    return ESP_OK;
}

esp_err_t synapse_edge_ai_deinit(void) {
    synapse_edge_ai_stop_inference_task();
    
    if (g_edge_ai_mutex) {
        vSemaphoreDelete(g_edge_ai_mutex);
        g_edge_ai_mutex = NULL;
    }
    
    triage_inference_deinit(&g_edge_ai.stress_triage);
    triage_inference_deinit(&g_edge_ai.motion_classifier);
    
    g_edge_ai.initialized = false;
    g_edge_ai.models_loaded = false;
    ESP_LOGI(TAG, "Edge AI deinitialized");
    return ESP_OK;
}