## firmware/esp32_band/Kconfig.projbuild
```kconfig
# Synapse Band v1 - Project-level Kconfig
# Firmware version, hardware version, and feature flags

config SYNAPSE_FIRMWARE_VERSION
    string "Firmware version string"
    default "1.0.0"
    help
        Firmware version reported via Device Information Service and OTA.

config SYNAPSE_HARDWARE_VERSION
    string "Hardware version string"
    default "band-v1.0"
    help
        Hardware version (PCB revision) reported via Device Information Service.

menu "Synapse Band Features"

config SYNAPSE_FEATURE_GPS
    bool "Enable GPS (MAX-M10S)"
    default y
    help
        Enable GPS tracking via UART. Required for sport sessions.

config SYNAPSE_FEATURE_TEMPERATURE
    bool "Enable skin temperature (TMP117)"
    default y
    help
        Enable TMP117 I2C temperature sensor for skin/core temp estimation.

config SYNAPSE_FEATURE_FIT_STORAGE
    bool "Enable FIT file storage on LittleFS"
    default y
    help
        Enable FIT writer with LittleFS backend for session recording.

config SYNAPSE_FEATURE_PROVISIONING
    bool "Enable BLE provisioning (WiFi + Cloud + mTLS)"
    default y
    help
        Enable provisioning flow via BLE GATT for WiFi credentials, cloud URL, and device certificates.

config SYNAPSE_FEATURE_OTA
    bool "Enable OTA updates with Ed25519 verification"
    default y
    help
        Enable signed OTA firmware updates with automatic rollback on 3 failed boots.

config SYNAPSE_FEATURE_EDGE_AI
    bool "Enable Edge AI (Stress Triage + Motion Classifier)"
    default y
    help
        Enable TFLM inference for stress triage (3-class) and motion classification.

config SYNAPSE_FEATURE_POWER_MONITOR
    bool "Enable power budget monitoring"
    default y
    help
        Enable battery ADC monitoring and tier affordability checks.

endmenu
```

## firmware/esp32_band/config/Kconfig
```kconfig
# Synapse Band v1 - Config Module Kconfig

menu "Synapse Band Firmware"

config SYNAPSE_FIRMWARE_VERSION
    string "Firmware version string"
    default "1.0.0"
    help
        Firmware version reported via Device Information Service and OTA.

config SYNAPSE_HARDWARE_VERSION
    string "Hardware version string"
    default "band-v1.0"
    help
        Hardware version (PCB revision) reported via Device Information Service.

endmenu

menu "Synapse Band Features"

config SYNAPSE_FEATURE_GPS
    bool "Enable GPS (MAX-M10S)"
    default y
    help
        Enable GPS tracking via UART. Required for sport sessions.

config SYNAPSE_FEATURE_TEMPERATURE
    bool "Enable skin temperature (TMP117)"
    default y
    help
        Enable TMP117 I2C temperature sensor for skin/core temp estimation.

config SYNAPSE_FEATURE_FIT_STORAGE
    bool "Enable FIT file storage on SPIFFS"
    default y
    help
        Enable FIT writer with SPIFFS backend for session recording.

        This flag gates the code, not only the menu entry: with it off
        synapse_fit_init() is a no-op, no session file is written, and a FIT
        mount failure is logged as a warning and the device keeps running
        (the BLE research service is the dataset path, the flash file is
        only an export).

        The component itself stays in the graph (with the same "always
        reachable" rule as the other optional components): the flag decides
        the behaviour, and the graph decides nothing, so the two can never
        disagree.

config SYNAPSE_FEATURE_PROVISIONING
    bool "Enable BLE provisioning (WiFi + Cloud + mTLS)"
    default y
    help
        Enable provisioning flow via BLE GATT for WiFi credentials, cloud URL, and device certificates.

        This flag gates the code: with it off synapse_provisioning_init()
        is not called, the provisioning characteristic refuses writes, and
        the device advertises in normal mode only. The band-core build does
        not link the Wi-Fi stack either.

config SYNAPSE_FEATURE_OTA
    bool "Enable OTA updates with rollback"
    default y
    help
        Enable OTA firmware updates with automatic rollback on failed boots.

        This flag gates the code: with it off neither synapse_ota_init()
        nor synapse_ota_process() are called.

config SYNAPSE_FEATURE_EDGE_AI
    bool "Enable Edge AI (Stress Triage + Motion Classifier)"
    default n
    help
        Enable TFLM inference for stress triage (3-class) and motion classification.

        Off by default: the inference task is never started and the interpreter
        is constructed inside its own tensor arena (triage_inference.cpp), which
        corrupts memory once it runs. Fix that before turning this on. With it
        off the feature stream reports stress_level = unknown, never a fabricated class.

config SYNAPSE_FEATURE_POWER_MONITOR
    bool "Enable power budget monitoring"
    default y
    help
        Enable battery ADC monitoring and tier affordability checks.

config SYNAPSE_FEATURE_RESEARCH_SERVICE
    bool "Enable Synapse Research Service (raw sample streaming)"
    default y
    help
        Expose a second, host-facing GATT service that streams raw samples
        (ECG/PPG/IMU) plus on-device timestamps, with zero on-device
        features.

        This is the dataset path: the project's asset is the multimodal raw
        record (Architecture.md), so signal quality, HRV and fusion are
        computed on the host. It is deliberately separate from the consumer
        "feature stream" (HR/RR/SQI/stress) used by the Averyn product
        integration, which carries features only.

config SYNAPSE_FEATURE_WIRED_SYNC
    bool "Enable wired GPIO sync (pod<->hub hardware marker)"
    default y
    help
        Compile the wired-sync driver (GPIO 10) used to align two pods with a
        hardware pulse. The smoke kit's two-pod bench is where the pod<->pod
        residual is measured; the feature itself is gated behind G2 (a real
        head pod on a second body site), so the driver ships early and stays
        unused until then. The single-pod G1 bringup never asserts the line
        as an input, and a missing wire is therefore harmless.

endmenu

menu "Synapse Band Hardware Configuration"

config SYNAPSE_ECG_ADC_CHANNEL
    int "ECG ADC Channel (ADC1)"
    default 0
    range 0 7
    help
        ADC1 channel for AD8232 output. On the ESP32-S3 ADC1_CH0 = GPIO1
        (GPIO36 is octal-PSRAM on the N8R8 module and cannot be used).

config SYNAPSE_ECG_GPIO_DRDY
    int "ECG DRDY/Lead-off GPIO (-1 to disable)"
    default 15
    help
        GPIO for AD8232 lead-off detection (LO+ and LO- OR-ed on the module's
        single LO output). -1 to disable. Not GPIO4: that is the battery ADC.

config SYNAPSE_ECG_VREF_MV
    int "ECG ADC Reference Voltage (mV)"
    default 1100
    help
        ADC reference voltage for ESP32-S3 ADC calibration.

config SYNAPSE_ECG_GAIN
    int "ECG AD8232 Gain (x100)"
    default 600
    help
        AD8232 gain setting. 600 = 6.0x gain.

config SYNAPSE_PPG_I2C_PORT
    int "PPG I2C Port"
    default 0
    range 0 1
    help
        I2C port for MAX30102 (0 or 1).

config SYNAPSE_PPG_I2C_ADDR
    hex "PPG I2C Address"
    default 0x57
    help
        I2C address for MAX30102.

config SYNAPSE_PPG_GPIO_INT
    int "PPG Interrupt GPIO"
    default 5
    help
        GPIO for MAX30102 INT pin.

config SYNAPSE_PPG_LED_CURRENT_RED
    hex "PPG Red LED Current"
    default 0x1F
    help
        MAX30102 red LED current register value (0x00-0x3F).

config SYNAPSE_PPG_LED_CURRENT_IR
    hex "PPG IR LED Current"
    default 0x1F
    help
        MAX30102 IR LED current register value (0x00-0x3F).

config SYNAPSE_PPG_LED_CURRENT_GREEN
    hex "PPG Green LED Current"
    default 0x0F
    help
        MAX30102 green LED current register value (0x00-0x3F).

config SYNAPSE_PPG_SAMPLE_RATE
    hex "PPG Sample Rate Register (SPO2_SR code)"
    default 0x00
    help
        MAX30102 SPO2_SR code, per datasheet: 0x00=50Hz, 0x01=100Hz, 0x02=200Hz,
        0x03=400Hz, 0x04=800Hz, 0x05=1000Hz, 0x06=1600Hz, 0x07=3200Hz.
        There is no 64 Hz setting. On-device HR/HRV and edge triage are designed
        for 50 Hz (ppg_dsp.h), so anything but 0x00 fails the build.

config SYNAPSE_PPG_PULSE_WIDTH
    hex "PPG Pulse Width Register"
    default 0x03
    help
        MAX30102 pulse width register. 0x03=411µs.

config SYNAPSE_PPG_ADC_RANGE
    hex "PPG ADC Range Register"
    default 0x03
    help
        MAX30102 ADC range register. 0x03=16384nA.

config SYNAPSE_IMU_I2C_PORT
    int "IMU I2C Port"
    default 0
    range 0 1
    help
        I2C port for ICM-20948 (shared with PPG).

config SYNAPSE_IMU_I2C_ADDR
    hex "IMU I2C Address"
    default 0x68
    help
        I2C address for ICM-20948.

config SYNAPSE_IMU_GPIO_INT
    int "IMU Interrupt GPIO"
    default 6
    help
        GPIO for ICM-20948 INT pin.

config SYNAPSE_IMU_ACCEL_FSR_G
    int "IMU Accelerometer FSR (g)"
    default 8
    range 2 16
    help
        Accelerometer full-scale range in g.

config SYNAPSE_IMU_GYRO_FSR_DPS
    int "IMU Gyroscope FSR (dps)"
    default 500
    range 250 2000
    help
        Gyroscope full-scale range in dps.

config SYNAPSE_IMU_ACCEL_ODR_HZ
    int "IMU Accelerometer ODR (Hz)"
    default 50
    help
        Accelerometer output data rate in Hz.

config SYNAPSE_IMU_GYRO_ODR_HZ
    int "IMU Gyroscope ODR (Hz)"
    default 50
    help
        Gyroscope output data rate in Hz.

config SYNAPSE_GPS_UART_PORT
    int "GPS UART Port"
    default 1
    range 0 2
    help
        UART port for MAX-M10S GPS module.

config SYNAPSE_GPS_UART_TX_GPIO
    int "GPS UART TX GPIO"
    default 17
    help
        GPIO for GPS UART TX.

config SYNAPSE_GPS_UART_RX_GPIO
    int "GPS UART RX GPIO"
    default 18
    help
        GPIO for GPS UART RX.

config SYNAPSE_GPS_BAUDRATE
    int "GPS UART Baudrate"
    default 115200
    help
        GPS UART baudrate for UBX protocol.

config SYNAPSE_GPS_USE_UBX
    bool "Use UBX binary protocol (vs NMEA)"
    default y
    help
        Use UBX binary protocol for efficiency. NMEA only for debug.

config SYNAPSE_TEMP_I2C_PORT
    int "Temperature I2C Port"
    default 0
    range 0 1
    help
        I2C port for TMP117 (shared with PPG/IMU).

config SYNAPSE_TEMP_I2C_ADDR
    hex "Temperature I2C Address"
    default 0x48
    help
        I2C address for TMP117.

config SYNAPSE_TEMP_GPIO_ALERT
    int "Temperature Alert GPIO (-1 to disable)"
    default 7
    help
        GPIO for TMP117 ALERT pin. -1 to disable.

config SYNAPSE_BAT_ADC_CHANNEL
    int "Battery ADC Channel (ADC1)"
    default 3
    range 0 7
    help
        ADC1 channel for battery voltage divider. On the ESP32-S3 ADC1_CH3 = GPIO4.

config SYNAPSE_BAT_VOLTAGE_DIVIDER
    int "Battery Voltage Divider Ratio (x100)"
    default 200
    help
        Voltage divider ratio * 100. 200 = 2.0 (1:1 divider).

config SYNAPSE_INA219_I2C_PORT
    int "INA219 I2C Port"
    default 0
    range 0 1
    help
        I2C port for the INA219 power monitor (shared with PPG/IMU).

config SYNAPSE_INA219_I2C_ADDR
    hex "INA219 I2C Address"
    default 0x40
    help
        I2C address for the INA219. 0x40 with A0/A1 grounded.

config SYNAPSE_INA219_SHUNT_MOHM
    int "INA219 Shunt Resistance (mOhm)"
    default 100
    range 1 1000
    help
        Shunt resistor in milliohms. 100 = 0.1 ohm, the value standard
        INA219 breakouts ship with.

config SYNAPSE_INA219_MAX_CURRENT_MA
    int "INA219 Max Expected Current (mA)"
    default 2000
    range 10 3200
    help
        Maximum expected current in mA. Selects the PGA range and the
        programmed current LSB; the range follows this value.

config SYNAPSE_BLE_DEVICE_NAME
    string "BLE Device Name"
    default "SYNAPSE-BAND"
    help
        BLE GAP device name for advertising.

config SYNAPSE_HUB_BATTERY_MAH
    int "Hub Battery Capacity (mAh)"
    default 3000
    help
        Battery capacity in mAh for power budget calculations.

config SYNAPSE_TARGET_LIFETIME_H
    int "Target Lifetime (hours)"
    default 24
    help
        Target battery lifetime in hours.

config SYNAPSE_RESERVE_MAH
    int "Reserve Capacity (mAh)"
    default 300
    help
        Reserve capacity to keep unused.

config SYNAPSE_T0_AVG_MW
    int "Tier 0 Average Power (mW)"
    default 5
    help
        Tier 0 (continuous) average power consumption in mW.

config SYNAPSE_T1_AVG_MW
    int "Tier 1 Average Power (mW)"
    default 50
    help
        Tier 1 (rest/sleep) average power consumption in mW.

config SYNAPSE_T2_AVG_MW
    int "Tier 2 Average Power (mW)"
    default 100
    help
        Tier 2 (voluntary) average power consumption in mW.

config SYNAPSE_SQI_MIN
    int "Minimum PPG SQI (x1000)"
    default 500
    help
        Minimum Signal Quality Index for motion gate (0.0-1.0, scaled by 1000).

config SYNAPSE_MAP_MAX
    int "Maximum Motion Artifact Probability (x1000)"
    default 500
    help
        Maximum Motion Artifact Probability for motion gate (0.0-1.0, scaled by 1000).

config SYNAPSE_REQUIRED_CONSECUTIVE_CLEAN
    int "Required Consecutive Clean Windows for Motion Gate"
    default 2
    help
        Number of consecutive clean SQI/MAP windows to arm motion gate.

endmenu
```

## firmware/esp32_tier0/sdkconfig.defaults
```kconfig
CONFIG_ESPTOOLPY_FLASHSIZE_4MB=y
CONFIG_ESPTOOLPY_FLASHSIZE=4MB
CONFIG_ESPTOOLPY_FLASHMODE_QIO=y
CONFIG_ESPTOOLPY_FLASHMODE="qio"
CONFIG_ESPTOOLPY_FLASHFREQ_80M=y
CONFIG_ESPTOOLPY_FLASHFREQ=80M

CONFIG_PARTITION_TABLE_CUSTOM=y
CONFIG_PARTITION_TABLE_CUSTOM_FILENAME="partitions.csv"
CONFIG_PARTITION_TABLE_FILENAME="partitions.csv"

CONFIG_FREERTOS_HZ=1000
CONFIG_FREERTOS_USE_TRACE_FACILITY=y
CONFIG_FREERTOS_VTASKLIST_INCLUDE_COREID=y
CONFIG_FREERTOS_GENERATE_RUN_TIME_STATS=y

CONFIG_ESP32S3_DEFAULT_CPU_FREQ_240=y
CONFIG_ESP32S3_DEFAULT_CPU_FREQ_MHZ=240

CONFIG_BT_ENABLED=y
CONFIG_BT_BLE_ENABLED=y
CONFIG_BT_NIMBLE_ENABLED=y
CONFIG_BT_NIMBLE_MAX_CONNECTIONS=1
CONFIG_BT_NIMBLE_MAX_BONDS=3
CONFIG_BT_NIMBLE_MAX_CCCDS=8
CONFIG_BT_NIMBLE_L2CAP_COC_MAX_NUM=0
CONFIG_BT_NIMBLE_MEM_ALLOC_MODE_INTERNAL=y
CONFIG_BT_NIMBLE_LOG_LEVEL=0

CONFIG_BT_NIMBLE_GATT_MAX_CLIENTS=1
CONFIG_BT_NIMBLE_GATT_MAX_SERVICES=10
CONFIG_BT_NIMBLE_GATT_MAX_ATTRS=32
CONFIG_BT_NIMBLE_GATT_MAX_CCCDS=8

CONFIG_BT_NIMBLE_SVC_GAP_DEVICE_NAME="SYNAPSE-Tier0"

CONFIG_ESP_SYSTEM_EVENT_TASK_STACK_SIZE=4096
CONFIG_ESP_MAIN_TASK_STACK_SIZE=4096
CONFIG_ESP_IPC_TASK_STACK_SIZE=2048
CONFIG_ESP_TIMER_TASK_STACK_SIZE=3072

CONFIG_LOG_DEFAULT_LEVEL_INFO=y
CONFIG_LOG_MAXIMUM_LEVEL_INFO=y

CONFIG_ADC_CAL_EFUSE_TP_FIT=y
CONFIG_ADC_CAL_EFUSE_VREF=y
CONFIG_ADC_ONESHOT_CTRL_FUNC_IN_IRAM=y

CONFIG_I2C_ISR_HANDLER_IN_IRAM=y

CONFIG_SPI_FLASH_CACHE_LINE_SIZE_64=y
CONFIG_SPI_FLASH_CACHE_LINE_SIZE=64

CONFIG_MBEDTLS_SSL_IN_CONTENT_LEN=16384
CONFIG_MBEDTLS_SSL_OUT_CONTENT_LEN=16384

CONFIG_LWIP_TCP_MSS=1460
CONFIG_LWIP_TCP_SND_BUF_DEFAULT=5760
CONFIG_LWIP_TCP_WND_DEFAULT=5760
CONFIG_LWIP_TCP_RECVMBOX_SIZE=32

CONFIG_ESP_TASK_WDT_TIMEOUT_S=30
CONFIG_ESP_TASK_WDT_CHECK_IDLE_TASK_CPU0=y
CONFIG_ESP_TASK_WDT_CHECK_IDLE_TASK_CPU1=y

CONFIG_ESP_INT_WDT_TIMEOUT_MS=1000

CONFIG_ESP_ERR_TO_NAME_LOOKUP=y
```
